## main/Kconfig.projbuild
```kconfig
menu "Wifi Credentials Configuration"

    config ESP_WIFI_SSID
        string "WiFi SSID"
        default "myssid"
        help
            SSID (network name) for the example to connect to.

    config ESP_WIFI_PASSWORD
        string "WiFi Password"
        default "mypassword"
        help
            WiFi password (WPA or WPA2) for the example to use.

    config ESP_MAXIMUM_RETRY
        int "Maximum retry"
        default 5
        help
            Set the Maximum retry to avoid station reconnecting to the AP unlimited when the AP is really inexistent.

    config BLINK_GPIO
        int "Blink GPIO number"
        range 0 34
        default 5
        help
            GPIO number (IOxx) to blink on and off.

            Some GPIOs are used for other purposes (flash connections, etc.) and cannot be used to blink.

            GPIOs 35-39 are input-only so cannot be used as outputs.
endmenu

menu "IotHub Configurations"
    config IOTHUB_CONNECTION_STRING
        string "IOT Hub Device Connection String"
        default ""
        help
            String containing Hostname, Device Id & Device Key in the format:
            HostName=<host_name>;DeviceId=<device_id>;SharedAccessKey=<device_key>
            You can get this from the Azure IoT CLI or the Azure Portal.

    config MESSAGE_INTERVAL_TIME
        int "Time delay in Milliseconds between two consecutive messages"
        default 100
        help
            Set time delay between two consecutive message sent to the cloud

    config MESSAGE_COUNT
        int "Total number of messages to be sent to the cloud"
        default 1
        help
            This example will terminate after sending these many
            messages. If the message count is set as 0 then this example
            will send indefinite messages to the cloud.
endmenu

menu "Ethernet Configuration"
    config EXAMPLE_ETH_MDC_GPIO
        int "SMI MDC GPIO number"
        default 23
        help
            Set the GPIO number used by SMI MDC.

    config EXAMPLE_ETH_MDIO_GPIO
        int "SMI MDIO GPIO number"
        default 18
        help
            Set the GPIO number used by SMI MDIO.
    
    config EXAMPLE_ETH_PHY_RST_GPIO
        int "PHY Reset GPIO number"
        default -1
        help
            Set the GPIO number used to reset PHY chip.
            Set to -1 to disable PHY chip hardware reset.

    config EXAMPLE_ETH_PHY_ADDR
        int "PHY Address"
        range 0 31
        default 0
        help
            Set PHY address according your board schematic.
endmenu

menu "Tipo de Conexao a ser usada"
    choice USE_INTERNET
        prompt "Tipo de conexao"
        help
            Select which kind of Ethernet will be used in the example.

        config ESP_ESCOLHA_CONEXAO_ETHERNET
            bool "Ethernet"
            help
                Habilitar Conexao ethernet

        config ESP_ESCOLHA_CONEXAO_WIFI
            bool "WiFi"
            help
               Habilitar Conexao wifi
        config ESP_ESCOLHA_CONEXAO_PPPOS
            bool "PPPos"
            help
                Habilitar conexao PPPos
    endchoice
endmenu

menu "PPPoS Configuration"
    config EXAMPLE_MODEM_PPP_AUTH_USERNAME
        string "Set username for authentication"
        default "espressif"
        depends on !EXAMPLE_MODEM_PPP_AUTH_NONE
        help
            Set username for PPP Authentication.

    config EXAMPLE_MODEM_PPP_AUTH_PASSWORD
        string "Set password for authentication"
        default "esp32"
        depends on !EXAMPLE_MODEM_PPP_AUTH_NONE
        help
            Set password for PPP Authentication.

    config EXAMPLE_MODEM_PPP_AUTH_NONE
        bool "Skip PPP authentication"
        default n
        help
            Set to true for the PPP client to skip authentication

    menu "UART Configuration"
        config EXAMPLE_MODEM_UART_TX_PIN
            int "TXD Pin Number"
            default 25
            range 0 31
            help
                Pin number of UART TX.

        config EXAMPLE_MODEM_UART_RX_PIN
            int "RXD Pin Number"
            default 26
            range 0 31
            help
                Pin number of UART RX.

        config EXAMPLE_MODEM_UART_RTS_PIN
            int "RTS Pin Number"
            default 27
            range 0 31
            help
                Pin number of UART RTS.

        config EXAMPLE_MODEM_UART_CTS_PIN
            int "CTS Pin Number"
            default 23
            range 0 31
            help
                Pin number of UART CTS.

        config EXAMPLE_MODEM_UART_EVENT_TASK_STACK_SIZE
            int "UART Event Task Stack Size"
            range 2000 6000
            default 2048
            help
                Stack size of UART event task.

        config EXAMPLE_MODEM_UART_EVENT_TASK_PRIORITY
            int "UART Event Task Priority"
            range 3 22
            default 5
            help
                Priority of UART event task.

        config EXAMPLE_MODEM_UART_EVENT_QUEUE_SIZE
            int "UART Event Queue Size"
            range 10 40
            default 30
            help
                Length of UART event queue.

        config EXAMPLE_MODEM_UART_PATTERN_QUEUE_SIZE
            int "UART Pattern Queue Size"
            range 10 40
            default 20
            help
                Length of UART pattern queue.

        config EXAMPLE_MODEM_UART_TX_BUFFER_SIZE
            int "UART TX Buffer Size"
            range 256 2048
            default 512
            help
                Buffer size of UART TX buffer.

        config EXAMPLE_MODEM_UART_RX_BUFFER_SIZE
            int "UART RX Buffer Size"
            range 256 2048
            default 1024
            help
                Buffer size of UART RX buffer.
    endmenu

endmenu

menu "Configuracao DPS"

config IOTHUB_CONNECTION_STRING
    string "IOT Hub Connection String"
	default ""
	help
		The IoT Hub Connection string - primary key in the format
		"HostName=<hostname>;SharedAccessKeyName=<shared_access_key_name>;SharedAccessKey=<shared_access_key>."
		You can get this from the Azure IoT CLI or the Azure Portal.

config DEVICE_COMMON_NAME
    string "Device Leaf Certificate Common Name"
    default "mydevice"
    help
        Common name of Leaf Certificate

config DPS_ID_SCOPE
    string "ID Scope of Device provisioning service"
    default "myidscope"
    help
        This is the unique ID scope of Device Provisioning Service (DPS), and can be found under "Overview"
        section of your DPS on azure IoT portal

endmenu
```

## sdkconfig.defaults
```kconfig
# Override some defaults to enable PPP
CONFIG_LWIP_PPP_SUPPORT=y
CONFIG_LWIP_PPP_NOTIFY_PHASE_SUPPORT=y
CONFIG_LWIP_PPP_PAP_SUPPORT=y
CONFIG_LWIP_TCPIP_TASK_STACK_SIZE=4096
# Do not enable IPV6 in dte<->dce link local
CONFIG_LWIP_PPP_ENABLE_IPV6=n

# Deve ser setada a connection string do iothub


# Partition Table
#
# CONFIG_PARTITION_TABLE_SINGLE_APP is not set
# CONFIG_PARTITION_TABLE_TWO_OTA is not set
CONFIG_PARTITION_TABLE_CUSTOM=y
CONFIG_PARTITION_TABLE_CUSTOM_FILENAME="partitions.csv"
CONFIG_PARTITION_TABLE_FILENAME="partitions.csv"
CONFIG_PARTITION_TABLE_OFFSET=0x8000
CONFIG_PARTITION_TABLE_MD5=y
# end of Partition Table

# FreeRtos
CONFIG_FREERTOS_SUPPORT_STATIC_ALLOCATION=y

#Rollback
CONFIG_BOOTLOADER_APP_ROLLBACK_ENABLE=y
# CONFIG_BOOTLOADER_APP_ANTI_ROLLBACK is not set
# CONFIG_BOOTLOADER_SKIP_VALIDATE_IN_DEEP_SLEEP is not set

# Tipo de Conexao a ser usada
#
# CONFIG_ESP_ESCOLHA_CONEXAO_ETHERNET is not set
# CONFIG_ESP_ESCOLHA_CONEXAO_WIFI is not set
CONFIG_ESP_ESCOLHA_CONEXAO_PPPOS=y
# end of Tipo de Conexao a ser usada

#
# PPPoS Configuration
#
CONFIG_EXAMPLE_MODEM_PPP_AUTH_USERNAME="vivo"
CONFIG_EXAMPLE_MODEM_PPP_AUTH_PASSWORD="vivo"
# CONFIG_EXAMPLE_MODEM_PPP_AUTH_NONE is not set

#
# UART Configuration
#
CONFIG_EXAMPLE_MODEM_UART_TX_PIN=27
CONFIG_EXAMPLE_MODEM_UART_RX_PIN=26
CONFIG_EXAMPLE_MODEM_UART_RTS_PIN=27
CONFIG_EXAMPLE_MODEM_UART_CTS_PIN=23
CONFIG_EXAMPLE_MODEM_UART_EVENT_TASK_STACK_SIZE=2048
CONFIG_EXAMPLE_MODEM_UART_EVENT_TASK_PRIORITY=5
CONFIG_EXAMPLE_MODEM_UART_EVENT_QUEUE_SIZE=35
CONFIG_EXAMPLE_MODEM_UART_PATTERN_QUEUE_SIZE=20
CONFIG_EXAMPLE_MODEM_UART_TX_BUFFER_SIZE=2048
CONFIG_EXAMPLE_MODEM_UART_RX_BUFFER_SIZE=2048
# end of UART Configuration
# end of PPPoS Configuration

#
# ESP-MODEM
#
CONFIG_EXAMPLE_COMPONENT_MODEM_APN="vivo.com.br"
# end of ESP-MODEM

# flash
# CONFIG_ESPTOOLPY_FLASHSIZE_2MB is not set
CONFIG_ESPTOOLPY_FLASHSIZE_4MB=y
CONFIG_ESPTOOLPY_FLASHMODE_QIO=y
CONFIG_FLASHMODE_QIO=y
CONFIG_ESPTOOLPY_FLASHFREQ="80m"
CONFIG_ESPTOOLPY_FLASHFREQ_80M=y
# CONFIG_ESPTOOLPY_FLASHSIZE_8MB is not set
# CONFIG_ESPTOOLPY_FLASHSIZE_16MB is not set
#

# VELOCIDADE
CONFIG_COMPILER_OPTIMIZATION_PERF=y
CONFIG_ESP32_DEFAULT_CPU_FREQ_240=y
CONFIG_ESP32_DEFAULT_CPU_FREQ_MHZ=240
#

#
# Ethernet Configuration
#
CONFIG_EXAMPLE_ETH_MDC_GPIO=23
CONFIG_EXAMPLE_ETH_MDIO_GPIO=18
CONFIG_EXAMPLE_ETH_PHY_RST_GPIO=-1
CONFIG_EXAMPLE_ETH_PHY_ADDR=0
# end of Ethernet Configuration


# RAM
CONFIG_SPIRAM_SUPPORT=y
CONFIG_ESP32_SPIRAM_SUPPORT=y
CONFIG_SPIRAM_TYPE_AUTO=y
CONFIG_SPIRAM_SIZE=-1
CONFIG_SPIRAM_SPEED_80M=y
CONFIG_SPIRAM=y
CONFIG_SPIRAM_BOOT_INIT=y
CONFIG_SPIRAM_USE_MALLOC=y
CONFIG_SPIRAM_MEMTEST=y
CONFIG_SPIRAM_MALLOC_ALWAYSINTERNAL=1024
CONFIG_SPIRAM_TRY_ALLOCATE_WIFI_LWIP=y
CONFIG_SPIRAM_MALLOC_RESERVE_INTERNAL=102400
CONFIG_SPIRAM_CACHE_WORKAROUND=y
#

#
# Ethernet
#
CONFIG_ETH_ENABLED=y
CONFIG_ETH_USE_ESP32_EMAC=y
CONFIG_ETH_PHY_INTERFACE_RMII=y
# CONFIG_ETH_PHY_INTERFACE_MII is not set
# CONFIG_ETH_RMII_CLK_INPUT is not set
CONFIG_ETH_RMII_CLK_OUTPUT=y
# CONFIG_ETH_RMII_CLK_OUTPUT_GPIO0 is not set
CONFIG_ETH_RMII_CLK_OUT_GPIO=17
CONFIG_ETH_DMA_BUFFER_SIZE=512
CONFIG_ETH_DMA_RX_BUFFER_NUM=10
CONFIG_ETH_DMA_TX_BUFFER_NUM=10
CONFIG_ETH_USE_SPI_ETHERNET=y
CONFIG_ETH_SPI_ETHERNET_DM9051=y
# CONFIG_ETH_USE_OPENETH is not set
# end of Ethernet
CONFIG_ESP_TLS_INSECURE=y
CONFIG_ESP_TLS_SKIP_SERVER_CERT_VERIFY=y
CONFIG_MBEDTLS_EXTERNAL_MEM_ALLOC=y
```
